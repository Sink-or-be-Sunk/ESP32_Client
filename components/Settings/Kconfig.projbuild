## components/Settings/Kconfig.projbuild
```kconfig
menu "Storage Configuration"
    config STORAGE_RESET_ALL
        bool
        default n
        prompt "Reset Non-Volatile Storage to Factory Defaults"
        help
            This erases the NVS that corresponds with saved user preferences

endmenu
```

## components/Websocket/Kconfig.projbuild
```kconfig
menu "Websocket Configuration"
    config WEBSOCKET_URI
        string "Websocket Server URI"
        default "ws://sink-or-be-sunk.herokuapp.com"
        help
            changing this uri will change the endpoint that the
            device attempts to connect for gameplay, registration, etc...
endmenu
```

## components/WifiManager/Kconfig.projbuild
```kconfig
menu "Wifi Configuration"
    config WIFI_NO_CONNECT_RETRY_CNT
        int
        default 5
        prompt "Max retries at connecting to network before resetting wifi provising"
        help
            Set the Maximum retry to avoid attempting to connect to a network that isn't available.
            Provisioned credentials are erased and internal state machine
            is reset after this threshold is reached.
            
    config WIFI_RESET_PROVISIONED
        bool
        default n
        prompt "Reset provisioned status of the device"
        help
            This erases the NVS to reset provisioned status of the device on every reboot.
            Provisioned status is determined by the Wi-Fi STA configuration, saved on the NVS.

    config WIFI_RESET_PROV_MGR_ON_FAILURE
        bool
        default y
        prompt "Reset provisioned credentials and state machine after session failure"
        help
            Enable reseting provisioned credentials and state machine after session failure.
            This will restart the provisioning service after retries are exhausted.

    config WIFI_PROV_MGR_MAX_RETRY_CNT
        int
        default 5
        prompt "Max retries before reseting provisioning state machine"
        depends on WIFI_RESET_PROV_MGR_ON_FAILURE
        help
            Set the Maximum retry to avoid reconnecting to an inexistent AP or if credentials
            are misconfigured. Provisioned credentials are erased and internal state machine
            is reset after this threshold is reached.

    config WIFI_PROV_SHOW_QR
        bool "Show provisioning QR code"
        default n
        help
            Show the QR code for provisioning.

    config WIFI_PROV_USING_BLUEDROID
        bool
        depends on (BT_BLUEDROID_ENABLED && (IDF_TARGET_ESP32C3 || IDF_TARGET_ESP32S3))
        select BT_BLE_42_FEATURES_SUPPORTED
        default y
        help
            This enables BLE 4.2 features for Bluedroid.
endmenu
```
